/**
 

**/

#include <Arduino.h>
#include <Wire.h>
#include <Servo.h>
#include <LedControl.h>
#include <Adafruit_NeoPixel.h>
#include "Colon.h"


Servo myservo1; //首サーボ用のオブジェクトを作成
Servo myservo2; //外部サーボ用のオブジェクトを作成
LedControl lc=LedControl(COLON_LC_DATAIN, COLON_LC_CLK, COLON_LC_LOAD, 1); //Ledmatrix
Adafruit_NeoPixel RGBLED = Adafruit_NeoPixel(1, COLON_RGBLED_PORT, NEO_RGB + NEO_KHZ800); //RGBLED

static char protchRingBuffer[RING_BUFFER_SIZE] ;
static String protchRetBuf ;
static int p_wpos, p_rpos ;
static int old_vs_status ;

static int t_calibration ;  // 温度計キャリブレーション


static byte lc_char[106][8]={
{B00000000,B11111100,B00010010,B00010010,B00010010,B11111100,B00000000,B00000000},
{B00000000,B11111110,B10010010,B10010010,B10010010,B01111100,B00000000,B00000000},
{B00000000,B01111100,B10000010,B10000010,B10000010,B01000100,B00000000,B00000000},
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{B00000000,B01001000,B11111110,B00100100,B00100100,B01111111,B00010010,B00000000}
};

/*
Colonクラス初期化
*/
Colon::Colon() {
	this->init() ;
}

/*
Colonクラス初期化
*/
void Colon::init() {
	/* GPIOの初期化 デジタルのみ*/
	pinMode(COLON_V_SW, INPUT);
	pinMode(COLON_EXT_POW_PORT, OUTPUT);
	pinMode(COLON_BUZZER, OUTPUT);
	pinMode(COLON_C_SW_LEFT, INPUT);
	pinMode(COLON_C_SW_RIGHT, INPUT);
	pinMode(COLON_RIP_PORT, INPUT);

	analogWrite(COLON_LED_PORT, 0) ;
	digitalWrite(COLON_BUZZER, 0) ;

	lc.shutdown(0,false);
	lc.setIntensity(0,COLON_LC_BRIGHTNESS);
	lc.clearDisplay(0);

	if (myservo1.attached()) {
		myservo1.detach();
	}
	if (myservo2.attached()) {
		myservo2.detach();
	}

	RGBLED.begin() ;                   // RGBLEDのライブラリを初期化する

	p_wpos = 0 ;
	p_rpos = 0 ;
	old_vs_status = -1 ;

	t_calibration = 0 ;



}

/*
Colonクラス初期化
*/
void Colon::runwait() {
	uint8_t value ;
	while(1) {
		value = digitalRead(COLON_C_SW_LEFT) ;
		if (value == 1) {
			break ;
		}
		value = digitalRead(COLON_C_SW_RIGHT) ;
		if (value == 1) {
			break ;
		}
		delay(100) ;
	}
    delay(1000) ;
}

/*
停止
	引数：
		無し
	返り値：
		無し

*/
void Colon::stopAll() {
	while(1) {
		delay(1000);
	}
}


/*
ブザー制御
	引数：
		Frequency (in hertz) and duration (in milliseconds).
	返り値：
		無し
*/
void Colon::controlBuzzer(uint16_t frequency, uint32_t duration) {
	int period ;
	int pulse ;

	if (frequency == 0) {
		digitalWrite(COLON_BUZZER, COLON_STATUS_OFF);
	}else{
		period = 1000000L / frequency;
		pulse = period / 2;
		if (duration != 0) {
			for (long i = 0; i < duration * 1000L; i += period) {
				if (frequency == 1) {
					digitalWrite(COLON_BUZZER, COLON_STATUS_OFF);
				}else{
					digitalWrite(COLON_BUZZER, COLON_STATUS_ON);
				}
				delayMicroseconds(pulse);
				digitalWrite(COLON_BUZZER, COLON_STATUS_OFF);
				delayMicroseconds(pulse);
			}
		}else{
			digitalWrite(COLON_BUZZER, COLON_STATUS_OFF);
		}
	}
}


/*
LED Matrix制御
	引数：
		row : 行
		col : 列
		value : ON/OFF (true / false)

	返り値：
		無し

*/
void Colon::controlLedmatrix(uint8_t row, uint8_t col, boolean value) {
	lc.setLed(0, col, (7-row), value);
}

/*
LED Matrix制御
	引数：
		code : 表示文字コード（A-Z,a-z,0-9,記号）

	返り値：
		無し

*/
void Colon::controlLedmatrixByChar(uint8_t code) {
	lc.setRow(0,0,lc_char[code][0]);
	lc.setRow(0,1,lc_char[code][1]);
	lc.setRow(0,2,lc_char[code][2]);
	lc.setRow(0,3,lc_char[code][3]);
	lc.setRow(0,4,lc_char[code][4]);
	lc.setRow(0,5,lc_char[code][5]);
	lc.setRow(0,6,lc_char[code][6]);
	lc.setRow(0,7,lc_char[code][7]);

}

/*
LED Matrix制御
	引数：
		row : 行
		value : １行の表示データ（8bit)

	返り値：
		無し

*/
void Colon::controlLedmatrixByRowData(uint8_t row, uint8_t value){
	lc.setColumn(0, row, (byte)value);
}

/*
LED Matrix制御
	引数：
		col : 行
		value : １行の表示データ（8bit)

	返り値：
		無し

*/
void Colon::controlLedmatrixByColData(uint8_t col, uint8_t value){
	unsigned r = 0;
	int b = 8;

	while (b--) {
		r <<= 1;
		r |= (value & 1);
		value >>= 1;
	}

	lc.setRow(0, (7-col), (byte)r);
}

/*
LED Matrix制御
	引数：
		無し
	返り値：
		無し

*/
void Colon::controlLedmatrixClear() {
	lc.clearDisplay(0);
}



/*
シリアルイベントハンドリング
（Serial1)
	引数：
		無し
	返り値：
		無し

*/
void Colon::serialEventHandler() {
	int inValue = 0 ;

	while (Serial1.available()) {
		inValue = Serial1.read() ;
		protchRingBuffer[p_wpos] = inValue ;
		p_wpos++ ;
		if (p_wpos >= RING_BUFFER_SIZE) {
			p_wpos = 0 ;
		}
	}
}



/*
シリアル文字列読み込み
	引数：
		無し
	返り値：
		文字列ポインタ

*/
String Colon::serialStringRead() {

	protchRetBuf = "";
	while(p_rpos != p_wpos) {
		protchRetBuf.concat(protchRingBuffer[p_rpos]);
		p_rpos++ ;
		if (p_rpos >= RING_BUFFER_SIZE) {
			p_rpos = 0 ;
		}
	}
	return protchRetBuf ;
}



/*
シリアル文字列書き込み
	引数：
		文字列ポインタ
	返り値：
		無し

*/
void Colon::serialStringWrite(String value) {
	int l = value.length();

	for(int i=0;i<l;i++){
		if ( (value.charAt(i) == '\r') || (value.charAt(i) == '\n')) {
			continue;
		}
		if ( (value.charAt(i) == 0xff) || (value.charAt(i) == 0x55)) {
			continue;
		}
		Serial1.write(value.charAt(i));
	}
}



/*
白色LED制御
	引数：
		level: 0-200

	返り値：
		無し

*/
void Colon::controlLED(uint8_t level) {
	int lv ;

	lv = level ;
	if (level <= 0 ) {
		lv = 0 ;
	}
	if (level >= 200 ) {
		lv = 200 ;
	}
	analogWrite(COLON_LED_PORT, lv);
}

/*
RGBLED制御
	引数：
		st: 輝度(0-255)
		cl: 色コード
#define RGBCOLOR_WHITE		1
#define RGBCOLOR_RED		2
#define RGBCOLOR_GREEN		3
#define RGBCOLOR_BLUE		4
#define RGBCOLOR_YELLOW		5
#define RGBCOLOR_CYAN		6
#define RGBCOLOR_MAGENTA	7

	返り値：
		無し

*/

void Colon::controlRGBLED(uint8_t st, uint8_t cl) {
	int	bt;

	bt = st ;
	if (st <= 0 ) {
		bt = 0 ;
	}
	if (st >= 255 ) {
		bt = 255 ;
	}
	RGBLED.setBrightness(bt) ;
	switch (cl) {
		case RGBCOLOR_WHITE :
			RGBLED.setPixelColor(0,255,255,255) ;
		break ;
		case RGBCOLOR_RED :
			RGBLED.setPixelColor(0,255,0,0) ;
		break ;
		case RGBCOLOR_GREEN :
			RGBLED.setPixelColor(0,0,255,0) ;
		break ;
		case RGBCOLOR_BLUE :
			RGBLED.setPixelColor(0,0,0,255) ;
		break ;
		case RGBCOLOR_YELLOW :
			RGBLED.setPixelColor(0,255,255,0) ;
		break ;
		case RGBCOLOR_CYAN :
			RGBLED.setPixelColor(0,0,255,255) ;
		break ;
		case RGBCOLOR_MAGENTA :
			RGBLED.setPixelColor(0,255,0,255) ;
		break ;
		default :
			RGBLED.setPixelColor(0,0,0,0) ;
		break ;
	}
	RGBLED.show() ;
}

/*
RGBLED制御
	引数：
		st: 輝度(0-255)
		r: R(0-255)
		g: G(0-255)
		b: B(0-255)

	返り値：
		無し

*/
void Colon::controlRGBLED2(uint8_t st, uint8_t r, uint8_t g, uint8_t b) {
	int	bt;

	bt = st ;
	if (st <= 0 ) {
		bt = 0 ;
	}
	if (st >= 255 ) {
		bt = 255 ;
	}
	RGBLED.setBrightness(bt) ;
	RGBLED.setPixelColor(0,r,g,b) ;
	RGBLED.show() ;
}

/*
首SERVO制御
	引数：
		pos: PIN番号 (COLON_SERVO_LEFT / COLON_SERVO_RIGHT）
		angle: 角度(30-150)

	返り値：
		無し

*/
void Colon::controlNeckServo(uint8_t angle) {
	if (!myservo1.attached()) {
		myservo1.attach(COLON_N_SERVO_PORT);
	}
	if (angle <= 30) {
		angle = 30;
	}
	if (angle >= 150) {
		angle = 150;
	}
	myservo1.write(angle);
}

/*
外部SERVO制御
	引数：
		pos: PIN番号 (COLON_SERVO_LEFT / COLON_SERVO_RIGHT）
		angle: 角度(0-180)

	返り値：
		無し

*/
void Colon::controlExtServo(uint8_t angle) {
	if (!myservo2.attached()) {
		myservo2.attach(COLON_E_SERVO_PORT);
	}
	if (angle <= 0) {
		angle = 0;
	}
	if (angle >= 180) {
		angle = 180;
	}
	myservo2.write(angle);
}

/*
振動スイッチ状況取得
	引数：
		なし

	返り値：
		値

*/
/*
int Colon::getVibrationSwatchStatus() {
	int value ;

	value = digitalRead(COLON_V_SW) ;
	if (value == COLON_STATUS_ON) {
		return COLON_STATUS_ON ;
	}
	return COLON_STATUS_OFF ;
}
*/

/*
振動スイッチ状況取得
	引数：
		なし

	返り値：
		変化があった場合、「１」　変化がない場合「０」

*/
int Colon::getVibrationSwatchStatus() {
	int value ;

	value = digitalRead(COLON_V_SW) ;
	if (old_vs_status == -1) {
		old_vs_status = value ;
		return COLON_STATUS_OFF ;
	}
	if (old_vs_status != value) {
		old_vs_status = value ;
		return COLON_STATUS_ON ;
	}
	return COLON_STATUS_OFF ;
}


/*
設定スイッチ状況取得
	引数：
		pin : 1 or 2 (1: LEFT, 2: RIGHT)

	返り値：
		0 or 1

*/
int Colon::getSettingSwatchStatus(uint8_t pin) {
	int value ;

	value = 0;
	if (COLON_SETTING_SW_LEFT == pin) {
		value = digitalRead(COLON_C_SW_LEFT) ;
	}else{
		value = digitalRead(COLON_C_SW_RIGHT) ;
	}
	return value ;
}

/*
ライトセンサ状態取得
	引数：
		なし
	返り値：
		0～1024までの値

*/
int Colon::getCDSStatus() {
	return analogRead(COLON_CDS_PORT) ;
}

/*
サーミスタ状態取得
	引数：
		なし
	返り値：
		摂氏温度

*/
int Colon::getTemperatureStatus() {
	float B=4013,T0=298.15,R0=20.0,R1=10.08,rr1,t,Tc;
	float sval1 ;


	int A_val1=analogRead(COLON_TMP_PORT);
	rr1=R1*A_val1/(1024.0-A_val1);
	t=1/(log(rr1/R0)/B+(1/T0));


	sval1 = t - 273.15 - 20 + t_calibration ;

	int tempC1 = sval1;

	return tempC1 ;
}

/*
マイク状態取得
	引数：
		pin : 1 or 2 (1: LEFT, 2: RIGHT)

	返り値：
		0～1024までの値

*/
int Colon::getMICStatus(uint8_t pin) {
	int value ;
	int value1 ;
	int value2 ;
	int port ;

	value1 = 0;
	value2 = 0;

	if (COLON_MIC_POS_LEFT == pin) {
		value = analogRead(COLON_MIC_LEFT) ;
	}else{
		value = analogRead(COLON_MIC_RIGHT) ;
	}
	value1 = (value - 512) * 2 ;
	value2 = ((value - 512) * -1) * 2 ;
	if (value1 <= value2) {
		return value2 ;
	}
	return value1 ;
}

/*
人感センサ状態取得
	引数：
		なし

	返り値：
		0 or 1の値

*/
int Colon::getRIPStatus() {
	return digitalRead(COLON_RIP_PORT) ;
}

/*
外部電源ON・OFF
	引数：
		sw :  0 or 1 (0: off / 1: on)

	返り値：
		なし

*/
void Colon::controlExtPower(uint8_t sw) {
	if (sw == COLON_STATUS_ON) {
		digitalWrite(COLON_EXT_POW_PORT, COLON_STATUS_ON) ;
	}else{
		digitalWrite(COLON_EXT_POW_PORT, COLON_STATUS_OFF) ;
	}
}


/*
温度計キャリブレーション設定
	引数：
		int cParam	温度較正（数値)
	返り値：
		無し

*/
void Colon::calibrationTemperature(int cParam) {

	if (cParam >= 128) {
		t_calibration = cParam - 256 ;
	}else{
		t_calibration = cParam ;
	}
}

